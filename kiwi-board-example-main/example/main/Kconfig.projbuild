## kiwi-board-example-main/example/main/Kconfig.projbuild
```kconfig
menu "Hackathon board demo"

    config HACK_SPEAKER_VOLUME
        int "Speaker volume (percent of full scale)"
        range 1 100
        default 25
        help
            Peak amplitude of generated tones. The MAX98357A is loud even at
            low values, keep it low when testing at a desk.

    config HACK_DISPLAY_ROTATE_180
        bool "Rotate display by 180 degrees"
        default n
        help
            Enable if the text on the OLED appears upside down.

    config HACK_LINK_SECRET
        string "Link secret (shared by your boards)"
        default ""
        help
            Boards only accept ESP-NOW packets signed with the same secret.
            Use the same value on every board of your team, keep it out of
            git (sdkconfig is gitignored), and pick something hard to guess.

    config HACK_LINK_TEST
        bool "Link test mode (run the board-to-board test instead of the game)"
        default n
        help
            Flash on both boards: each screen shows the other board's
            buttons. Needs the same Link secret on both.

endmenu
```
